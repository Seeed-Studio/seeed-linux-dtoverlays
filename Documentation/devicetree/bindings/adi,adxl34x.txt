## Documentation/devicetree/bindings/adi,adxl34x.txt
```
ADI ADXL345/ADXL346
===================

  Three-Axis Digital Accelerometer

Example:
--------

&i2c1 {
	status = "okay";

	adxl34x@53 {
		compatible = "adi,adxl34x";
		reg = <0x53>;
		status = "okay";
	};
};
```

## Documentation/devicetree/bindings/bme280.txt
```
BME280
======

  Barometer Sensor

Example:
--------

&i2c1 {
	status = "okay";

	bme280@76 {
		compatible = "bme280";
		reg = <0x76>;
		status = "okay";
	};
};
```

## Documentation/devicetree/bindings/hcsr04.txt
```
HCSR04 Ultrasonic Ranger
========================

  There is two type device interfaces, 1-pin or 2-pin device.
For 1-pin device, trigger pin is identical with echo pin.
For 2-pin device, trigger pin and echo pin are seperated.


Required properties:
--------------------
- compatbile : should be "hcsr04".
- gpios      : should specify the GPIO hcsr04 connected to.
               1-pin device only need single GPIO or two identical GPIO,
               2-pin device should specify 2 GPIOs, the trigger pin first,
               the echo pin second.


Example:
--------

Refer device tree source:
  dts/bbb/BB-GPIO-HCSR04.dts
```

## Documentation/devicetree/bindings/jhd1802.txt
```
JHD1802
=======

  JHD1802 is a i2c 16x2 charactor display device,
which use a HD44780 as core chip, and export a I2C interface.

Example:
--------

&i2c1 {
	status = "okay";

	jhd1802@3E {
		compatible = "seeed-hd44780";
		reg = <0x3E>;
		status = "okay";
	};
};
```

## Documentation/devicetree/bindings/mcp2518fd,jetpack6.x.txt
```
mcp2518fd
=======

  mcp2518fd is a board with 2channel CAN/CANFD. This document is to explain the driver use for Jetpack 6.x with linux 36.2 & 36.3.
  * With the link below is the process that communicate will Nvidia developer E2E.
  [jetson-agx-orin-spi-interface-with-2-ch-can-fd-hat-mcp2518fd-spi-module](https://forums.developer.nvidia.com/t/jetson-agx-orin-spi-interface-with-2-ch-can-fd-hat-mcp2518fd-spi-module/302264)

  * This link is the official testing on jetson orin nx with mcp2515 by nvidia on both Jetpack5.1.3 & Jetpack 6.x
  [MCP2515_Verification](https://elinux.org/Jetson/L4T/peripheral/#MCP2515_Verification)

  * For Jetpack 6.x, select the correspondant dtsi with your hardware.
  tegra234-p3768-0000+p3767-xxxx-nv-common.dtsi // Jetson Orin Nano
  tegra234-p3737-0000+p3701-xxxx-nv-common.dtsi // Jetson AGX Orin

  the fist pXXXX is core board, the second pXXXX is carrier board.

  Because the AGX Orin has only one spi, so I use the one SPI control two CAN channel mode.

Example:
--------

/* SPI1, 40pin header, Pin 19(MOSI), Pin 21(MISO), Pin 23(CLK), Pin 24(CS) */
spi@3210000{
	status = "okay";
	spi@0 {
		compatible = "microchip,mcp2518fd";
		reg = <0x0>;
		spi-max-frequency = <2000000>;
		interrupt-parent = <&gpio>;
		interrupts = <TEGRA234_MAIN_GPIO(Q, 5) IRQ_TYPE_LEVEL_LOW>;
		clocks = <&can_clock>;
		nvidia,enable-hw-based-cs;
		controller-data {
			nvidia,enable-hw-based-cs;
			nvidia,rx-clk-tap-delay = <0x10>;
			nvidia,tx-clk-tap-delay = <0x0>;
		};
	};
	spi@1 {
		compatible = "tegra-spidev";
		reg = <0x1>;
		spi-max-frequency = <50000000>;
		controller-data {
			nvidia,enable-hw-based-cs;
			nvidia,rx-clk-tap-delay = <0x10>;
			nvidia,tx-clk-tap-delay = <0x0>;
		};
	};

};
```

## Documentation/devicetree/bindings/p9813.txt
```
Chainable RGB LED (P9813)
========================

 RGB LED(p9813) always bring us vivid and magic light effect, especially when there
are a large number of LEDs shining together.

Required properties:
--------------------
- compatbile : should be "dms,p981x".
- gpios      : should specify the GPIO p981x connected to.
               should specify 2 GPIOs, the clock pin first,
               the data pin second.


Example:
--------

Refer device tree source:
  dts/bbb/BB-GPIO-P9813.dts
```

## Documentation/devicetree/bindings/seeed,eink.txt
```
Seeed E-lnk
===========

  Seeed Grove Triple Color E-Ink Display, export a UART interface to
draw/transfer display data.

Grove - Triple Color E-Ink Display 1.54"
  https://github.com/Seeed-Studio/Grove_Triple_Color_E-lnk_1.54
Grove - Triple Color E-Ink Display 2.13"
  https://github.com/Seeed-Studio/Grove_Triple_Color_E-lnk_2.13


Required properties:
--------------------
- compatbile : should be "seeed,eink".


Optional properties:
--------------------
- tty-port   : should specify the UART device path, default to "/dev/ttyS4"
- baudrate   : should specify the UART communication speed in bps,
               default to 230400
- lines-len  : should specify the line length, default to 152
- num-lines  : should specify the lines count, default to 152


Example:
--------

Refer device tree source:
  dts/bbb/BB-UART4-E-INK.dts
```

## Documentation/devicetree/bindings/sensirion,sht3x.txt
```
SHT3x
=====

  The SHT3x series, SHT30/31/35, is temperature and humidity sensors.

Example:
--------

&i2c1 {
	status = "okay";

	sht3x@44 {
		compatible = "sensirion,sht3x";
		reg = <0x44>;
		status = "okay";
	};
};
```

## Documentation/devicetree/bindings/st,lis331dlh.txt
```
LIS331DLH
=========

  The LIS331DLH ia an ultra low-power high performance three axies
linear accelerometer made by st.
Refer Linux kernel document
'Documentation/devicetree/bindings/iio/accel/lis302.txt'.

Example:
--------

&i2c1 {
	status = "okay";

	lis331dlh@18 {
		compatible = "st,lis331dlh";
		reg = <0x18>;
		status = "okay";
	};
};
```

## Documentation/devicetree/bindings/st,vl53l0x.txt
```
VL53L0x
=======

  High speed, high accuray and long range distance sensor made by st.

Example:
--------

&i2c1 {
	status = "okay";

	vl53l0x@29 {
		compatible = "st,vl53l0x";
		reg = <0x29>;
		status = "okay";
	};
};
```
