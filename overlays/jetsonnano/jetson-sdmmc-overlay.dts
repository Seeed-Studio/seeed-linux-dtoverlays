/*
 * Copyright (C) 2022 Seeed Studio
 *
 * MIT License
 *
 */

/dts-v1/;
/plugin/;

#include <dt-bindings/pinctrl/tegra210-p3448-0000-p3449-0000-a02.h>
#include <dt-bindings/pinctrl/pinctrl-tegra.h>

/ {
	overlay-name = "reComputer sdmmc";
	jetson-header-name = "Jetson 40pin Header";
	compatible = JETSON_COMPATIBLE;

	fragment@0 {
		target = <&sdmmc3>;
		__overlay__ {
			status = "okay";

			/**
			 * We provide SD card function on carrier board, which supports CLK Frequency 48MHz.
			 * Increasing CLK by yourself might cause certificates (such as CE/FCC) failure!
			 */
			max-clk-limit = <48000000>;
		};
	};
};
