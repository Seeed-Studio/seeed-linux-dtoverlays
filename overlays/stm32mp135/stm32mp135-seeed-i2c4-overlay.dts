/*
 * Device tree overlay for led
 */


#include "dt-bindings/gpio/gpio.h"
#include "dt-bindings/pinctrl/stm32-pinfunc.h"

/dts-v1/;
/plugin/;

/ {
    compatible = "st,stm32mp135f-dk", "st,stm32mp135";
    fragment@0 {
        target = <&i2c4>;
        __overlay__ {
            #address-cells = <1>;
            #size-cells = <0>;

            bma456@19 {
                compatible = "bosch,bma456";
                reg = <0x19>;
                status = "okay";
            };
        };
    };
};

