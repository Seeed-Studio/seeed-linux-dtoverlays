/*
 * Copyright (C) 2018 Seeed Studio
 * Peter Yang <turmary@126.com>
 *
 * MIT License
 *
 */
/dts-v1/;
/plugin/;

/ {
	fragment@0 {
		target-path="/";
		__overlay__ {

			aliases {
				/* SLOT I2C1 */
				//sht3x = "/ocp/i2c@4802a000/sht3x@44";
				/* SLOT I2C2 */
				sht3x = "/ocp/i2c@4819c000/sht3x@44";
			};
		};
	};

	fragment@1 {
		/* SLOT I2C1 */
		//target = <&i2c1>;
		/* SLOT I2C2 */

		target = <&i2c2>;

		__overlay__ {
			status = "okay";

			/* this is the configuration part */
			clock-frequency = <400000>;

			#address-cells = <1>;
			#size-cells = <0>;

			sht3x@44 {
				compatible = "sensirion,sht3x";
				reg = <0x44>;
				status = "okay";
			};
		};
	};
};

