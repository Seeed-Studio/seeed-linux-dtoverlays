/*
 * Copyright (C) 2018 Seeed Studio
 * Peter Yang <turmary@126.com>
 *
 * MIT License
 *
 */
/dts-v1/;
/plugin/;

/ {
	fragment@0 {
		target-path="/";
		__overlay__ {

			aliases {
				/* SLOT I2C1 */
				//vl53l0x = "/ocp/i2c@4802a000/vl53l0x@29";
				/* SLOT I2C2 */
				vl53l0x = "/ocp/i2c@4819c000/vl53l0x@29";
			};
		};
	};

	fragment@1 {
		/* SLOT I2C1 */
		//target = <&i2c1>;
		/* SLOT I2C2 */

		target = <&i2c2>;

		__overlay__ {
			status = "okay";

			/* this is the configuration part */
			clock-frequency = <400000>;

			#address-cells = <1>;
			#size-cells = <0>;

			vl53l0x@29 {
				compatible = "st,vl53l0x";
				reg = <0x29>;
				status = "okay";
			};
		};
	};
};

