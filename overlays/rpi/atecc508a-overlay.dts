/*
 * Copyright (C) 2020 Seeed Studio
 * Zhangqun Ming <north_sea@qq.com>
 *
 * MIT License
 *
 */
/dts-v1/;
/plugin/;

/ {
	compatible = "brcm,bcm2835", "brcm,bcm2708", "brcm,bcm2709";

	fragment@0 {
		target = <&i2c1>;
		__overlay__ {
			status = "okay";

			/* this is the configuration part */
			clock-frequency = <100000>;

			#address-cells = <1>;
			#size-cells = <0>;

			atecc508a@60 {
				compatible = "atmel,atecc508a";
				reg = <0x60>;
			};
		};
	};
};
