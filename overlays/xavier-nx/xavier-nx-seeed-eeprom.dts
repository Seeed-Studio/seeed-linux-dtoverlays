/*
 * Copyright (C) 2022 Seeed Studio
 *
 * MIT License
 *
 */

/dts-v1/;
/plugin/;

#include <dt-bindings/pinctrl/pinctrl-tegra.h>

/ {
    overlay-name = "Jetson Seeed EEPROM";
	jetson-header-name = "Jetson Xavier NX EEPROM";
    compatible = "nvidia,p3449-0000+p3668-0001", "nvidia,p3509-0000+p3668-0001", "nvidia,tegra194";

    fragment@0 {
		target-path = "/i2c@3160000";

		__overlay__ {
            #address-cells = <1>;
		    #size-cells = <0>;

			eeprom@57 {
                compatible = "atmel,24c02";
                reg = <0x57>;
                pagesize = <0x08>;
            };
		};
	};	
};

