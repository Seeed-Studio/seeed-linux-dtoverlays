/*
 * Copyright (C) 2019 Seeed Technology Co,Ltd  - https://www.seeed.cc
 * Author: Baozhu Zuo <zuobaozhu@gmail.com>
 *
 * This program is free software; you can redistribute it and/or modify
 * it under the terms of the GNU General Public License version 2 as
 * published by the Free Software Foundation.
 */
#include "imx6ul-pinfunc.h"
/dts-v1/;
/plugin/;


/ {
     compatible = "fsl,imx6ull-14x14-evk", "fsl,imx6ull";
        /*
         * Helper to show loaded overlays under: /proc/device-tree/chosen/overlays/
         */
        fragment@0 {
                target = <&i2c2>;
                __overlay__ {
                        clock_frequency = <100000>;
                        pinctrl-names = "default";
                        pinctrl-0 = <&pinctrl_i2c2>;
                        status = "okay";


                };
        };

        fragment@1 {
                target = <&iomuxc>;
                __overlay__ {
                        pinctrl_i2c2: i2c2grp@12 {
                            fsl,pins = <
                                MX6UL_PAD_UART5_TX_DATA__I2C2_SCL 0x4001b8b0
                                MX6UL_PAD_UART5_RX_DATA__I2C2_SDA 0x4001b8b0
                            >;
                        };
                };
        };

};
